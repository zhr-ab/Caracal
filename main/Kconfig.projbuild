## main/Kconfig.projbuild
```kconfig
menu "Browser Configuration"

    config BROWSER_WIFI_SSID
        string "Wi-Fi SSID"
        default "MyWiFi"
        help
            Wi-Fi SSID to connect to.

    config BROWSER_WIFI_PASSWORD
        string "Wi-Fi Password"
        default "MyPassword"
        help
            Wi-Fi password.

    config BROWSER_DEFAULT_URL
        string "Default URL"
        default "http://example.com"
        help
            Default URL to load on startup.

    config BROWSER_LCD_SPI_HOST
        int "SPI Host (1=SPI2, 2=SPI3)"
        default 2
        help
            SPI peripheral to use for LCD.

    config BROWSER_LCD_PIN_CLK
        int "LCD SPI CLK Pin"
        default 14

    config BROWSER_LCD_PIN_MOSI
        int "LCD SPI MOSI Pin"
        default 13

    config BROWSER_LCD_PIN_MISO
        int "LCD SPI MISO Pin"
        default 12

    config BROWSER_LCD_PIN_DC
        int "LCD DC Pin"
        default 21

    config BROWSER_LCD_PIN_CS
        int "LCD CS Pin"
        default 10

    config BROWSER_LCD_PIN_RST
        int "LCD RST Pin"
        default 11

    config BROWSER_LCD_PIN_BL
        int "LCD Backlight Pin"
        default 48

    config BROWSER_LCD_WIDTH
        int "LCD Width"
        default 480

    config BROWSER_LCD_HEIGHT
        int "LCD Height"
        default 320

    config BROWSER_LCD_ROTATION
        int "LCD Rotation (0, 90, 180, 270)"
        default 0

    config BROWSER_TOUCH_SDA
        int "Touch I2C SDA Pin"
        default 38

    config BROWSER_TOUCH_SCL
        int "Touch I2C SCL Pin"
        default 39

    config BROWSER_TOUCH_INT
        int "Touch Interrupt Pin"
        default 40

    config BROWSER_TOUCH_ADDR
        hex "Touch I2C Address"
        default 0x38
        help
            FT6336: 0x38, CST816S: 0x15, GT911: 0x5D or 0x14

    config BROWSER_MAX_HTML_SIZE
        int "Max HTML size (bytes)"
        default 262144
        help
            Maximum HTML document size to fetch and parse.

    config BROWSER_HTTP_TIMEOUT_MS
        int "HTTP timeout (ms)"
        default 10000

endmenu
```

## sdkconfig.defaults
```kconfig
# ESP32-S3 specific settings
CONFIG_IDF_TARGET="esp32s3"

# PSRAM (8MB OCTAL)
CONFIG_ESP32S3_SPIRAM_SUPPORT=y
CONFIG_SPIRAM_MODE_OCT=y
CONFIG_SPIRAM_SPEED_80M=y
CONFIG_SPIRAM_FETCH_INSTRUCTIONS=y
CONFIG_SPIRAM_RODATA=y
CONFIG_SPIRAM_TRY_ALLOCATE_WIFI_LWIP=y

# SPI RAM malloc - allow malloc() to return PSRAM memory for large allocs
# This lets LVGL's internal allocator use PSRAM transparently
CONFIG_SPIRAM_MALLOC_ALWAYSINTERNAL=16384

# Wi-Fi
CONFIG_ESP_WIFI_STATIC_RX_BUFFER_NUM=4
CONFIG_ESP_WIFI_DYNAMIC_RX_BUFFER_NUM=16
CONFIG_ESP_WIFI_DYNAMIC_TX_BUFFER_NUM=16

# HTTP client - disable HTTPS to save flash
CONFIG_ESP_HTTP_CLIENT_ENABLE_HTTPS=n

# LWIP
CONFIG_LWIP_MAX_SOCKETS=6

# Main task stack size
CONFIG_ESP_MAIN_TASK_STACK_SIZE=8192

# FreeRTOS
CONFIG_FREERTOS_HZ=1000

# Flash size
CONFIG_ESPTOOLPY_FLASHSIZE_16MB=y

# Partition table - use custom with SPIFFS for fonts
CONFIG_PARTITION_TABLE_CUSTOM=y
CONFIG_PARTITION_TABLE_CUSTOM_FILENAME="partitions.csv"

# ---- LVGL Configuration ----
# NOTE: Run `idf.py menuconfig` -> Component Config -> LVGL Configuration
# to fine-tune. Key settings to verify:
#   - Enable Montserrat fonts: 10, 12, 14, 16, 20, 24
#   - Set default font to Montserrat 14
#   - Enable UTF-8 text encoding
#   - Set memory size >= 256KB (LVGL will use PSRAM via malloc)
#   - Enable scrollbar
#   - Enable filesystem (for font loading from SPIFFS)
```
